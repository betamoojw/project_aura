    "---",
    "--",
    "0%",
    "--:--",
    "--.--.----",
    "C",
    "F",
    "ppb",
    "Index",
    "HCHO",
    "AQI",
    "Inizializzazione",
    "Aria fresca - Tutto ok",
    "Eccellente",
    "Buono",
    "Moderato",
    "Scarso",
    "OFF",
    "ON",
    "OK",
    "ERR",
    "SYNC",
    "Connesso",
    "Modalità AP",
    "Errore",
    "Connessione",
    "Disattivato",
    "No Wi-Fi",
    "Connesso",
    "Errore",
    "Riprova (10m)",
    "Riprova (1h)",
    "Connessione...",
    "ON / OFF",
    "Ogni 6h",
    "http://192.168.4.1",
    "http://aura.local/mqtt",
    "http://aura.local/theme",
    "CO2 molto alto! Arieggia ora",
    "CO2 alto - Arieggia presto",
    "CO2 in aumento - Considera ventilazione",
    "PM2.5 molto alto! Purifica - stop fumo",
    "PM2.5 alto - Purifica - controlla fonte",
    "PM2.5 elevato - Valuta purificatore",
    "PM10 molto alto! Purifica - controlla fonte",
    "PM10 alto - Purifica - riduci polvere",
    "PM10 elevato - Purifica - riduci polvere",
    "HCHO molto alto! Arieggia - rimuovi fonte",
    "HCHO alto - Arieggia - rimuovi fonte",
    "HCHO rilevato - Controlla fonti",
    "VOC molto alto! Trova fonte - arieggia",
    "VOC alto - Aumenta ventilazione",
    "NOx molto alto! Ferma fonte - arieggia",
    "NOx alto - Usa cappa - controlla fonte",
    "NOx elevato - Controlla cucina/esterno",
    "Temp troppo bassa! Riscalda",
    "Temp bassa - Riscalda la stanza",
    "Temp un po' bassa - Più calore",
    "Temp troppo alta! Raffredda",
    "Temp alta - Arieggia / raffredda",
    "Temp un po' alta - Più aria",
    "DP molto basso! Umidifica",
    "DP basso - Aria può sembrare secca",
    "DP afoso! Deumidifica",
    "DP molto alto - Arieggia/deumidifica",
    "DP alto - Aria può essere afosa",
    "Umidità molto bassa! Umidifica",
    "Umidità molto bassa - Usa umidificatore",
    "Umidità bassa - Valuta umidificatore",
    "Umidità molto alta! Deumidifica",
    "Umidità molto alta - Deumidifica",
    "Umidità alta - Più ventilazione",
    "IMPOSTAZIONI",
    "IMPOST",
    "INDIETRO",
    "OFFSET TEMP",
    "OFFSET UMID",
    "MODO NOTTE",
    "C / F",
    "STATO HEAD",
    "WI-FI",
    "ORA / DATA",
    "COLORE TEMA",
    "MQTT",
    "AUTO NOTTE",
    "RIAVVIA",
    "RESET\nFABBRICA",
    "CO2\nCALIBRAZIONE",
    "INFO",
    "PUNTI\nINDICATORI",
    "ALLARME\nLAMPEGGIA",
    "VOC\nRIAPPRENDI",
    "RETROILL.",
    "IMPOSTAZIONI WI-FI",
    "Stato Wi-Fi:",
    "Per configurare il Wi-Fi:\n- Premi ON / OFF\n- Connetti telefono o PC a \"ProjectAura-Setup\".\n- Apri http://192.168.4.1 o scansiona QR.\n- Seleziona la rete Wi-Fi e inserisci la password.\n",
    "SSID:",
    "IP:",
    "DIMENTICA\nWI-FI",
    "RICOLLEGA",
    "AVVIA AP",
    "IMPOSTAZIONI MQTT",
    "Stato MQTT:",
    "Per configurare MQTT:\n- Connetti Project Aura al WI-FI prima\n- Apri http://aura.local/mqtt o scansiona QR.",
    "IP dispositivo:",
    "IP broker:",
    "Topic:",
    "RICOLLEGA",
    "DATA E ORA",
    "FUSO ORARIO",
    "SYNC AUTO (NTP)",
    "IMPOSTA ORA",
    "Ore:",
    "Minuti:",
    "IMPOSTA DATA",
    "Giorno:",
    "Mese:",
    "Anno:",
    "ORA",
    "APPLICA",
    "RTC:",
    "WIFI:",
    "NTP:",
    "STATO: ",
    "TEMP",
    "UMIDITÀ",
    "PRESSIONE",
    "RISCALD.",
    "RESET VOC",
    "RIAVVIA",
    "RESET",
    "ANNULLA",
    "Reset calibrazione VOC?",
    "L'apprendimento VOC/NOx riparte.\nLetture instabili per alcune ore.",
    "Riavvia dispositivo?",
    "Il dispositivo si riavvia.\nLetture in pausa brevemente.",
    "Reset di fabbrica?",
    "Cancella Wi-Fi, offset, temi,\nprogrammi e stato VOC.\nAzione irreversibile.",
    "TEMA:",
    "PERSON.",
    "PRESET",
    "ESEMPIO:",
    "Per tema personalizzato:\n- Connetti Project Aura al WI-FI prima\n- Apri http://aura.local/theme\n  o scansiona QR.\n- Salva con Indietro",
    "MODO NOTTE AUTO",
    "Attiva colori \"Modo Notte\" a orario.\n- Imposta inizio e fine.\n- Interruttore su ON.\n- Modo Notte manuale disattivato\n  quando Auto Notte è ON.",
    "ORA INIZIO",
    "ORA FINE",
    "RETROILLUMINAZ.",
    "Misura aria a schermo spento.\nSensori attivi. Tocca per svegliare.",
    "SONNO PROGRAM.",
    "RISPARMIO",
    "DORMI ALLE",
    "SVEGLIA ALLE",
    "SEMPRE",
    "30 SEC",
    "1 MIN",
    "5 MIN",
    "Calibrazione CO2 (Aria fresca)",
    "CALIBRA\nCO2",
    "- ASC (Auto Self-Calibration): ON per default.\n- Ideale se CO2 scende vicino esterno ogni settimana\n  (buona ventilazione / stanza vuota).\n- ASC regola lentamente (giorni, non istantaneo).\n- Con ASC ON, calibrazione manuale\n  di solito non necessaria.",
    "- Alimenta con power bank.\n- Porta all'aperto in aria pulita.\n- Lontano da persone, finestre, auto, fumo, bocchette.\n- Lascia 10 min (min 5).\n- Premi Calibra CO2 e non muovere.\n- Calibrazione manuale solo diagnostica.\n- Non più di una volta / 6 mesi.\n- Riferimento 420 ppm.\n- Condizioni errate peggiorano letture.",
    "TOCCA PER CONTINUARE",
    "DIAGNOSTICA BOOT",
    "Sistema",
    "Sensori",
    "App:",
    "MAC:",
    "Reset:",
    "Heap:",
    "Memoria:",
    "I2C:",
    "Touch:",
    "SEN66:",
    "SFA30:",
    "PCF8523:",
    "Errori rilevati",
    "OK (config)",
    "OK (default)",
    "RECUPERATO",
    "RILEVATO",
    "FALLITO",
    "AVVIO",
    "NON TROVATO",
    "PERSO",
    "AH molto basso! Umidifica",
    "AH basso - Usa umidificatore",
    "AH alto - Rischio muffa",
    "AH molto alto! Muffa rapida",
    "La temperatura influisce su comfort, produttività e qualità del sonno. Soglie basate su ASHRAE 55 (comfort termico) e raccomandazioni OMS. L'intervallo ottimale aiuta a mantenere la concentrazione e riduce la fatica. Gli estremi causano disagio, sonnolenza o difficoltà di concentrazione. L'esposizione prolungata può influire sulla salute.",
    "Eccellente: 20-25°C (68-77°F)\nIntervallo ideale per comfort e produttività",
    "Accettabile: 18-20°C o 25-26°C (64-68°F o 77-79°F)\nLeggermente fuori dall'ottimo, ancora confortevole",
    "Scomodo: 16-18°C o 26-28°C (61-64°F o 79-82°F)\nDisagio evidente, produttività ridotta",
    "Scarso: <16°C o >28°C (<61°F o >82°F)\nDisagio significativo, intervenire",
    "L'indice VOC misura i composti organici volatili da vernici, mobili, detergenti e cosmetici. Basato sull'algoritmo Sensirion SGP (scala 1-500). Valori più alti indicano maggiore concentrazione di VOC. L'esposizione prolungata può causare mal di testa, irritazione oculare e fatica. Arieggiare se elevato. Indicatore blu = sensore in riscaldamento.",
    "Eccellente: ≤150\nAria interna normale, nessuna azione",
    "Accettabile: 151-250\nVOC leggermente elevati, valutare ventilazione",
    "Scomodo: 251-350\nOdori possibili, ventilazione consigliata",
    "Scarso: >350\nProbabili mal di testa e irritazione, arieggiare subito",
    "L'indice NOx misura gli ossidi di azoto da combustione: fornelli a gas, riscaldatori, veicoli, fumo di tabacco. Basato sull'algoritmo Sensirion SGP (scala 1-500). Livelli alti irritano le vie respiratorie e peggiorano l'asma. Usa la cappa quando cucini a gas. Indicatore blu = sensore in riscaldamento.",
    "Eccellente: ≤50\nAria pulita, nessuna fonte di combustione",
    "Accettabile: 51-100\nLieve aumento, assicurare ventilazione",
    "Scomodo: 101-200\nSottoprodotti di combustione evidenti, ventilare",
    "Scarso: >200\nAlta esposizione NOx, irritazione probabile, identifica la fonte",
    "La formaldeide (HCHO) è un VOC cancerogeno rilasciato da legno pressato, mobili, pavimenti, adesivi e tessuti. Soglie basate sulle linee guida OMS (~80 µg/m³ ≈ 65 ppb). Mobili nuovi e ristrutturazioni sono fonti principali. Causa irritazione a occhi, naso e gola. I livelli diminuiscono nel tempo (degassamento). Arieggiare gli ambienti nuovi per alcune settimane.",
    "Eccellente: <30 ppb\nLivello sicuro, nessuna irritazione attesa",
    "Accettabile: 30-60 ppb\nBassa esposizione, i sensibili possono avvertire lieve irritazione",
    "Scomodo: 60-100 ppb\nPossibile irritazione occhi/gola, aumentare ventilazione",
    "Scarso: >100 ppb\nRischio salute, esposizione prolungata nociva",
    "La CO2 indica la qualità dell'aria interna e l'efficacia della ventilazione. Soglie basate su ASHRAE e UBA. L'aria esterna è ~400 ppm. Sopra 1000 ppm calano le prestazioni cognitive; sopra 1500 ppm causano sonnolenza e mal di testa. Una buona ventilazione mantiene la CO2 bassa per concentrazione e salute.",
    "Eccellente: <800 ppm\nQualità ottimale per concentrazione e produttività",
    "Accettabile: 800-1000 ppm\nPossibile lieve calo di concentrazione",
    "Scomodo: 1000-1500 ppm\nFatica evidente, prestazioni cognitive ridotte",
    "Scarso: >1500 ppm\nSonnolenza, mal di testa, difficoltà di concentrazione",
    "Le PM2.5 sono particelle fini che penetrano in profondità nei polmoni e nel sangue. Soglie basate su AQI EPA e OMS. L'esposizione a lungo termine è legata a malattie respiratorie e cardiovascolari. Fonti: cucina, candele, inquinamento esterno, fumo. Mantieni bassi i livelli indoor con filtrazione e ventilazione.",
    "Eccellente: ≤12 µg/m³\nAria pulita, nessun impatto sulla salute",
    "Accettabile: >12-35 µg/m³\nI sensibili possono avvertire lieve irritazione",
    "Scomodo: >35-55 µg/m³\nPossibile fastidio respiratorio, limitare esposizione",
    "Scarso: >55 µg/m³\nRischio salute, evita esposizione prolungata",
    "Le PM10 sono particelle grossolane: polvere, polline e spore di muffa. Soglie basate su AQI EPA. Possono irritare occhi, naso e gola. Meno dannose delle PM2.5 ma incidono sulla salute respiratoria. Fonti: polvere, lavori, polline, particelle stradali. Riduci con pulizia regolare, filtrazione e finestre chiuse.",
    "Eccellente: ≤54 µg/m³\nAria pulita, nessuna irritazione attesa",
    "Accettabile: >54-154 µg/m³\nI sensibili possono avvertire lieve irritazione",
    "Scomodo: >154-254 µg/m³\nPossibile irritazione occhi/gola, limitare esposizione",
    "Scarso: >254 µg/m³\nProbabile fastidio respiratorio, evitare esposizione prolungata",
    "Il cambio di pressione in 3 ore mostra variazioni rapide del tempo e effetti sul benessere. I cali precedono i temporali e possono scatenare sintomi acuti nei sensibili: emicrania, dolori articolari, vertigini. Utile per la pianificazione a breve. Se senti stanchezza o mal di testa improvviso, controlla questo valore: il calo di pressione può esserne la causa.",
    "Eccellente: <1.0 hPa\nTempo stabile, nessun disagio atteso",
    "Accettabile: 1.0-3.0 hPa\nTempo in cambiamento, possibile lieve fatica",
    "Scomodo: 3.0-6.0 hPa\nFronte in arrivo, possibili mal di testa e dolori articolari",
    "Scarso: >6.0 hPa\nCambiamento rapido, probabili emicrania e fatica",
    "Il cambio di pressione in 24 ore mostra tendenze meteo e stress prolungato sul corpo. Grandi oscillazioni indicano fronti forti o tempeste. I sensibili possono avvertire fatica persistente, cambi d'umore o peggioramento del dolore cronico. Utile per pianificare la giornata e prevedere i sintomi nelle ore successive.",
    "Eccellente: <2.0 hPa\nTempo stabile, confortevole per tutti",
    "Accettabile: 2.0-6.0 hPa\nTempo in cambiamento, possibili sintomi lievi",
    "Scomodo: 6.0-10.0 hPa\nPassaggio di fronte/temporale, maggior disagio",
    "Scarso: >10.0 hPa\nEvento severo, sintomi forti probabili",
    "L'umidità influisce sul comfort respiratorio, sulla pelle e sulla temperatura percepita. Soglie basate su ASHRAE 55 ed EPA. L'intervallo ottimale (40-60%) evita vie respiratorie secche e limita la muffa. Umidità bassa causa pelle secca, irritazione e staticità. Umidità alta favorisce muffa, acari e disagio. L'equilibrio è fondamentale.",
    "Eccellente: 40-60%\nComfort ottimale, sano per vie respiratorie e pelle",
    "Accettabile: 30-40% o 60-65%\nLeggera secchezza o umidità, possibile lieve disagio",
    "Scomodo: 20-30% o 65-70%\nPelle secca/irritazione o sensazione appiccicosa",
    "Scarso: <20% o >70%\nRischio salute: problemi respiratori o muffa",
    "L'umidità assoluta misura la massa reale di vapore acqueo nell'aria (g/m³), indipendente dalla temperatura. Livelli bassi seccano vie respiratorie e pelle. Livelli alti rendono difficile raffreddarsi e favoriscono la muffa. Utile per decidere la ventilazione e confrontare aria interna/esterna. L'intervallo ottimale sostiene salute respiratoria e comfort.",
    "Eccellente: 7-15 g/m³\nUmidità ottimale, respirazione confortevole",
    "Accettabile: 5-7 o 15-18 g/m³\nUn po' secco o umido, possibile lieve disagio",
    "Scomodo: 4-5 o 18-20 g/m³\nSecchezza o afa evidente, disagio probabile",
    "Scarso: <4 o >20 g/m³\nMolto secco o umido, problemi respiratori",
    "Il punto di rugiada indica il comfort di umidità meglio dell'umidità relativa. Mostra quanto l'aria appare afosa o secca. Un punto basso significa aria secca che irrita pelle e vie respiratorie. Un punto alto è appiccicoso e opprimente, rendendo difficile raffreddarsi sudando. L'intervallo ideale offre respirazione confortevole e raffreddamento naturale.",
    "Eccellente: 10-16°C (50-61°F)\nComfort ideale, respirazione piacevole",
    "Accettabile: 8-10°C (46-50°F) o 16-18°C (61-64°F)\nLeggermente secco o umido, ancora confortevole",
    "Scomodo: 5-8°C (41-46°F) o 18-21°C (64-70°F)\nSecco o afoso, disagio evidente",
    "Scarso: <5°C (<41°F) o >21°C (>70°F)\nTroppo secco o opprimente, disagio per la salute",
    "TEMPERATURA",
    "FORMALDEIDE",
    "UMIDITÀ RELATIVA",
    "UMIDITÀ ASSOLUTA",
    "PUNTO DI RUGIADA",
